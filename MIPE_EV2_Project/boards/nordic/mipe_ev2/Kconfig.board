## MIPE_EV2_Project/boards/nordic/mipe_ev2/Kconfig.board
```kconfig
config BOARD_MIPE_EV2_NRF54L15_CPUAPP
	bool "MIPE_EV2 nRF54L15 Application MCU"
	depends on SOC_NRF54L15_CPUAPP
```

## MIPE_EV2_Project/boards/nordic/mipe_ev2/Kconfig.defconfig
```kconfig
if BOARD_MIPE_EV2_NRF54L15_CPUAPP

config BOARD
	default "mipe_ev2_nrf54l15_cpuapp"

endif # BOARD_MIPE_EV2_NRF54L15_CPUAPP
```

## boards/nordic/mipe_ev1/Kconfig.board
```kconfig
# Copyright (c) 2025
# SPDX-License-Identifier: Apache-2.0

source "boards/$(BOARD_DIR)/Kconfig.mipe_ev1"
```

## boards/nordic/mipe_ev1/Kconfig.defconfig
```kconfig
# Copyright (c) 2025
# SPDX-License-Identifier: Apache-2.0

if BOARD_MIPE_EV1_NRF54L15_CPUAPP

config BOARD
	default "mipe_ev1"

endif # BOARD_MIPE_EV1_NRF54L15_CPUAPP
```

## boards/nordic/mipe_ev1/Kconfig.mipe_ev1
```kconfig
# Copyright (c) 2025
# SPDX-License-Identifier: Apache-2.0

config BOARD_MIPE_EV1
	bool "MIPE EV1 Board"

if BOARD_MIPE_EV1

config BOARD_MIPE_EV1_NRF54L15_CPUAPP
	bool "MIPE EV1 nRF54L15 CPU APP"
	select SOC_NRF54L15_CPUAPP

endif # BOARD_MIPE_EV1
```

## boards/nordic/mipe_ev1/board.yml
```yaml
board:
  name: mipe_ev1
  full_name: MIPE EV1 Board
  vendor: custom
  socs:
    - name: nrf54l15
```

## boards/nordic/mipe_ev1/mipe_ev1_nrf54l15_cpuapp_defconfig
```kconfig
# Copyright (c) 2025
# SPDX-License-Identifier: Apache-2.0

# System Clock (32 MHz - revert to previously stable setting)
CONFIG_SYS_CLOCK_HW_CYCLES_PER_SEC=32000000

# Explicitly disable UART/console (no UART hardware on MIPE_EV1)
CONFIG_SERIAL=n
CONFIG_CONSOLE=n
CONFIG_UART_CONSOLE=n

# Enable GPIO
CONFIG_GPIO=y

# Enable MPU (matches working ev1_mipe project)
CONFIG_ARM_MPU=y
```
